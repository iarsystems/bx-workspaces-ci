//-------------------------------------------------------------------------
//      ILINK command file template for the Renesas RH850 G3M microcontroller
//
//      This file can be used to link object files from the RH850
//      Assembler, IASMRH850, and the C/C++ compiler ICCRH850.
//
//-------------------------------------------------------------------------

// Do not edit these default values.
//
define symbol _SELF_SIZE_DEFAULT     = 0x00040000;  // SELF_AREA size
define symbol _SELF_BEGIN_DEFAULT    = 0xFEDC0000;  // SELF_AREA start address
define symbol _SELF_OFFSET_1_DEFAULT = 0x00040000;  // Offset for PE1

if (isdefinedsymbol(_SELF_SIZE) == 0)
{
  define symbol _SELF_SIZE     = _SELF_SIZE_DEFAULT;
  define symbol _SELF_BEGIN    = _SELF_BEGIN_DEFAULT;
  define symbol _SELF_OFFSET_1 = _SELF_OFFSET_1_DEFAULT;
}
else  // _SELF_SIZE is already defined
{
  if (_SELF_SIZE > _SELF_SIZE_DEFAULT * 2)
  {
    error "The value of the symbol _SELF_SIZE is too large.";
  }
  if (_SELF_SIZE <= 0)
  {
    error "The value of the symbol _SELF_SIZE must be a positive number greater than 0.";
  }
  if (_SELF_SIZE % 8 != 0)
  {
    error "The value of the symbol _SELF_SIZE must be divisible by 8.";
  }

  define symbol _SELF_DIFF     = _SELF_SIZE_DEFAULT - _SELF_SIZE;
  define symbol _SELF_BEGIN    = _SELF_BEGIN_DEFAULT + _SELF_DIFF;
  define symbol _SELF_OFFSET_1 = _SELF_OFFSET_1_DEFAULT + _SELF_DIFF;
}

define memory mem with size = 4G;                                        // Section name    Memory type
                                                                         // ------------    -----------

define region ROM_near        = mem:[from 0x00000000 to 0x00007FFF];     // <code default>  Code FLASH
define region ROM_1ST_region  = mem:[from 0x00000000 to 0x003FFFFF];     // <code default>  Code FLASH
define region ROM_2ND_region  = mem:[from 0x01000000 to 0x01007FFF];     // SECOND_ROM      Code FLASH
define region ROM_3RD_region  = mem:[from 0x00000000 size 0];
define region ROM_4TH_region  = mem:[from 0x00000000 size 0];
define region ROM_5TH_region  = mem:[from 0x00000000 size 0];
define region ROM_6TH_region  = mem:[from 0x00000000 size 0];
define region ROM_7TH_region  = mem:[from 0x00000000 size 0];
define region ROM_8TH_region  = mem:[from 0x00000000 size 0];
define region ROM_9TH_region  = mem:[from 0x00000000 size 0];
define region ROM_10TH_region = mem:[from 0x00000000 size 0];
define region ROM_11TH_region = mem:[from 0x00000000 size 0];
define region ROM_12TH_region = mem:[from 0x00000000 size 0];
define region ROM_13TH_region = mem:[from 0x00000000 size 0];
define region ROM_14TH_region = mem:[from 0x00000000 size 0];
define region ROM_15TH_region = mem:[from 0x00000000 size 0];
define region ROM_16TH_region = mem:[from 0x00000000 size 0];

define region RAM_near       = mem:[from 0x00000000 size 0];
define exported symbol _RAM_1ST_BEG = 0xFED80000;
define exported symbol _RAM_1ST_END = 0xFEDFFFFF;
define region RAM_1ST_region = mem:[from _RAM_1ST_BEG to _RAM_1ST_END];  // <data default>  Local RAM self/mirror area
define exported symbol _RAM_2ND_BEG = 0x00000000;
define exported symbol _RAM_2ND_END = 0x00000000;
define region RAM_2ND_region = mem:[from 0x00000000 size 0];
define exported symbol _RAM_3RD_BEG = 0x00000000;
define exported symbol _RAM_3RD_END = 0x00000000;
define region RAM_3RD_region = mem:[from 0x00000000 size 0];
define exported symbol _RAM_4TH_BEG = 0x00000000;
define exported symbol _RAM_4TH_END = 0x00000000;
define region RAM_4TH_region = mem:[from 0x00000000 size 0];
define exported symbol _RAM_5TH_BEG = 0x00000000;
define exported symbol _RAM_5TH_END = 0x00000000;
define region RAM_5TH_region = mem:[from 0x00000000 size 0];
define exported symbol _RAM_6TH_BEG = 0x00000000;
define exported symbol _RAM_6TH_END = 0x00000000;
define region RAM_6TH_region = mem:[from 0x00000000 size 0];
define exported symbol _RAM_7TH_BEG = 0x00000000;
define exported symbol _RAM_7TH_END = 0x00000000;
define region RAM_7TH_region = mem:[from 0x00000000 size 0];
define exported symbol _RAM_8TH_BEG = 0x00000000;
define exported symbol _RAM_8TH_END = 0x00000000;
define region RAM_8TH_region = mem:[from 0x00000000 size 0];
define exported symbol _RAM_9TH_BEG = 0x00000000;
define exported symbol _RAM_9TH_END = 0x00000000;
define region RAM_9TH_region = mem:[from 0x00000000 size 0];
define exported symbol _RAM_10TH_BEG = 0x00000000;
define exported symbol _RAM_10TH_END = 0x00000000;
define region RAM_10TH_region = mem:[from 0x00000000 size 0];
define exported symbol _RAM_11TH_BEG = 0x00000000;
define exported symbol _RAM_11TH_END = 0x00000000;
define region RAM_11TH_region = mem:[from 0x00000000 size 0];
define exported symbol _RAM_12TH_BEG = 0x00000000;
define exported symbol _RAM_12TH_END = 0x00000000;
define region RAM_12TH_region = mem:[from 0x00000000 size 0];

define exported symbol _SELF_AREA_COMMON_BEG = _SELF_BEGIN;
define exported symbol _SELF_AREA_COMMON_END = _SELF_BEGIN + _SELF_SIZE - 1;
define region SELF_AREA_region =
  mem:[from _SELF_AREA_COMMON_BEG to _SELF_AREA_COMMON_END];             // SELF_AREA       Local RAM self/mirror area

define region SELF_AREA_1_region = mem:[from 0xFED80000 to 0xFEDFFFFF];

reserve region "Reserved by local RAM CPU-specific access" =
  (SELF_AREA_1_region - SELF_AREA_region);

define exported symbol _LOC_1ST_BEG = 0xFEB80000;
define exported symbol _LOC_1ST_END = 0xFEBFFFFF;
define region LOC_1ST_region = mem:[from _LOC_1ST_BEG to _LOC_1ST_END];  // LOCAL1_RAM      Local RAM for PE1
define region LOC_1ST_SELF_EXCLUSION_region =
  mem:[from _LOC_1ST_BEG + _SELF_OFFSET_1 size _SELF_SIZE];

define exported symbol _LOC_2ND_BEG = 0x00000000;
define exported symbol _LOC_2ND_END = 0x00000000;
define region LOC_2ND_region = mem:[from 0x00000000 size 0];
define exported symbol _LOC_3RD_BEG = 0x00000000;
define exported symbol _LOC_3RD_END = 0x00000000;
define region LOC_3RD_region = mem:[from 0x00000000 size 0];
define exported symbol _LOC_4TH_BEG = 0x00000000;
define exported symbol _LOC_4TH_END = 0x00000000;
define region LOC_4TH_region = mem:[from 0x00000000 size 0];
define exported symbol _LOC_5TH_BEG = 0x00000000;
define exported symbol _LOC_5TH_END = 0x00000000;
define region LOC_5TH_region = mem:[from 0x00000000 size 0];
define exported symbol _LOC_6TH_BEG = 0x00000000;
define exported symbol _LOC_6TH_END = 0x00000000;
define region LOC_6TH_region = mem:[from 0x00000000 size 0];
define exported symbol _LOC_7TH_BEG = 0x00000000;
define exported symbol _LOC_7TH_END = 0x00000000;
define region LOC_7TH_region = mem:[from 0x00000000 size 0];

reserve region "Reserved by local RAM common self area access" =
  LOC_1ST_SELF_EXCLUSION_region;

define exported symbol _RAM_RET_BEG = 0x3FCE4000;
define exported symbol _RAM_RET_END = 0x3FCE7FFF;
define region RAM_RET_region = mem:[from _RAM_RET_BEG to _RAM_RET_END];  // RETENTION_RAM   Retention RAM

//Uncomment and adapt the following section if you want to place the interrupt tables at specific addresses.
// define block .interrupt_core1 with alignment = 8 {
//   ro section .table.interrupt_core_1 };
//
// "INTERRUPT":place at address mem:0x200
// {
//   block .interrupt_core1
// };

include "layout.icf";

//-------------------------------------------------------------------------
//      End of file
//-------------------------------------------------------------------------
